## patches/opensbi/Kconfig
```kconfig
# SPDX-License-Identifier: BSD-2-Clause

config PLATFORM_VIVADO_RISC_V
	bool
	select FDT
	select IPI_MSWI
	select IRQCHIP_PLIC
	select TIMER_MTIMER
        select FDT_TIMER
	default y
```

## patches/opensbi/configs/defconfig
```kconfig
CONFIG_PLATFORM_VIVADO_RISC_V=y
CONFIG_FDT_IPI=y
CONFIG_FDT_IPI_MSWI=y
CONFIG_FDT_IPI_PLICSW=y
CONFIG_FDT_IRQCHIP=y
CONFIG_FDT_IRQCHIP_APLIC=y
CONFIG_FDT_IRQCHIP_IMSIC=y
CONFIG_FDT_IRQCHIP_PLIC=y
CONFIG_FDT_TIMER=y
CONFIG_FDT_TIMER_MTIMER=y
CONFIG_FDT_TIMER_PLMT=y
```

## patches/u-boot/vivado_riscv64_defconfig
```kconfig
CONFIG_RISCV=y
CONFIG_DISTRO_DEFAULTS=y

CONFIG_ENV_SIZE=0x4000
CONFIG_SYS_BOOTM_LEN=0x2000000
CONFIG_SYS_LOAD_ADDR=0x80200000
CONFIG_SYS_MALLOC_F_LEN=0x4000
CONFIG_NR_DRAM_BANKS=1
CONFIG_TARGET_VIVADO_RISCV64=y
CONFIG_ARCH_RV64I=y
CONFIG_RISCV_SMODE=y
CONFIG_FIT=y
CONFIG_MISC_INIT_R=y
CONFIG_DISPLAY_CPUINFO=y
CONFIG_DISPLAY_BOARDINFO=y
CONFIG_SYS_RELOC_GD_ENV_ADDR=y
CONFIG_DM_MTD=y
CONFIG_OF_CONTROL=y
CONFIG_OF_BOARD=y

#CONFIG_LOG=y
#CONFIG_MAX_LOG_LEVEL=LOGL_DEBUG
```
